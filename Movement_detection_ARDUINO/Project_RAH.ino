#include <NanoEdgeAI.h>
#include <knowledge.h>

/*
This code will display what movement the Arduino card user is doing, thanks of the NanoEdgeAI librairy found before.
Thanks to an app like LightBlue (availible on iOS and Android), you can receive datas in live.
To start, when using the dispositif with the Arduino card, you have to launch the app and then connect yourself to "Arduino".
Then, you click on the link permiting you to read and notify datas.
You have to choice, first you can read datas ie you can click on "read again" to read one information only when you want.
Else you can click on "Listen for notifications", it will display continuously all the informations about your movements.
*/


/* Configuration */

#include <Arduino_LSM9DS1.h> //accelerometer functions module
#include <ArduinoBLE.h> //bluetooth functions module

#include <NanoEdgeAI.h> //NanoEdgeAI functions and DATA_INPUT_USER, AXIS_NUMBER, CLASS_NUMBER define
#include <knowledge.h> //datas for the initialization

//Ble serive UUID generated by : https://www.guidgenerator.com/online-guid-generator.aspx
BLEService NanoEdgeAIService("11851262-7ce1-436f-8f29-998812b815ff");
//To be able reading informations sent by bluetooth
BLEUnsignedCharCharacteristic movementChar ("11851262-7ce1-436f-8f29-998812b815ff", BLERead | BLENotify);

//Datas structures for accelerations measure
float acc_buffer[DATA_INPUT_USER * AXIS_NUMBER] = { 0 }; //Accelerations buffer
float acc_x = 0.F;
float acc_y = 0.F;
float acc_z = 0.F;

//Datas strucutres for NanoEdgeAI
int class_threshold = 1; //0 means NanoEdgeAI_classifier returns the most likely class for a buffer
                         //1 means NanoEdgeAI_classifier returns a class  whose probability is greater than 0.5, or 0 otherwhise.
float output_buffer[CLASS_NUMBER] = {0};

/* Setup */

void setup() {
  //Serial configuration, waiting 3s in order to avoid any haste
  Serial.begin(9600);
  while(!Serial);

  //LED configuration, to notify the advancement
  pinMode(LED_BUILTIN, OUTPUT);

  //NanoEdgeAI initialization
  uint8_t error_code = NanoEdgeAI_knowledge_init(knowledge);
  if (error_code != 0)
  {
    Serial.println("Datas could not be load");
  }

  //Modules initializing verifications
  if (!BLE.begin() || !IMU.begin())
  {
    Serial.println("Failed to initialize IMU or BLE!");
    while (1);
  }

  //BLE Service configuration : local name, adding service (UUID), setting initial value
  BLE.setLocalName("Movement");
  BLE.setAdvertisedService(NanoEdgeAIService);
  NanoEdgeAIService.addCharacteristic(movementChar);
  BLE.addService(NanoEdgeAIService);
  movementChar.writeValue(0);

  //Start advertising
  BLE.advertise();
  Serial.println("Waiting for bluetooth connexion on the app");
}


/* Loop */

void loop() {
  //Waiting for a bluetooth connection and for accelerations data
  BLEDevice central = BLE.central();
  if (central && IMU.accelerationAvailable())
  {
    //Print the central's BT address:
    Serial.print("Connected to central: ");
    Serial.println(central.address());

    //Turn on the LED for 3sec to indicate the new connection:
    digitalWrite(LED_BUILTIN, HIGH);
    delay(1000);
    digitalWrite(LED_BUILTIN, LOW);

    //Main loop
    int actual_class = 0;
    int previous_class = 0;
    long previousMillis = 0;
    while(central.connected())
    {
        //We check the movement every 0.2sec. This avoids a disconnection due to a 'delay()'
        long currentMillis = millis();
        if (currentMillis - previousMillis >= 2000)
        {
            fill_acc_buffer();
            actual_class = NanoEdgeAI_classifier(input_user_buffer, output_class_buffer, class_threshold);
            get_output_values();
            //actual_class = (acc_buffer[0]*1000 + acc_buffer[1]*1000 + acc_buffer[2]*1000)/3;
            if (actual_class != previous_class)
            {
              Serial.print("Mouvement n° :");
              Serial.println(actual_class);
              get_acc_values();
              
              movementChar.writeValue(actual_class);
      
              previous_class = actual_class;
            }
            previousMillis = currentMillis;
        }
      
    }
    Serial.print("Disconnected from central: ");
    Serial.println(central.address());    
  }
}

/* Functions */

void fill_acc_buffer() {
  //Acceleration buffer. Module frequency is set by default at 119Hz,
  //but there is no way to change it except to change it in the module main code.
  //To get around this, we neglect one in two sample to move frequency to 59.5Hz (almost 50Hz)
    
    for (int i = 0; i < 2*DATA_INPUT_USER; i++) {
      IMU.readAcceleration(acc_x, acc_y, acc_z);
      if (i%2 == 0)
      {
        acc_buffer[AXIS_NUMBER * (i/2)] = acc_x;
        acc_buffer[AXIS_NUMBER * (i/2) + 1] = acc_y;
        acc_buffer[AXIS_NUMBER * (i/2) + 2] = acc_z;
      }
    }
}

void get_acc_values() {

    for (int i = 0; i < DATA_INPUT_USER; i++) 
    {
      Serial.println(acc_buffer[AXIS_NUMBER * i]);
      Serial.println(acc_buffer[AXIS_NUMBER * i +1]);
      Serial.println(acc_buffer[AXIS_NUMBER * i +2]);
    }

}

void get_output_values() {
  for (int i =0; i < CLASS_NUMBER; i++)
  {
    Serial.println(output_class_buffer[i]);
  }
}
